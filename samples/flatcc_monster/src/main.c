/*
 * FlatCC Monster sample — ported to Zephyr.
 *
 * Based on upstream flatcc/samples/monster/monster.c.
 * Demonstrates schema-generated FlatBuffer creation and reading
 * using Zephyr kernel allocators.
 */

#include <zephyr/kernel.h>
#include <string.h>

#include "monster_builder.h"   /* Generated by flatcc from monster.fbs */

/* The reader is already pulled in by the builder, but explicit for clarity. */
#include "monster_reader.h"

#undef ns
#define ns(x) FLATBUFFERS_WRAP_NAMESPACE(MyGame_Sample, x)

#define c_vec_len(V) (sizeof(V) / sizeof((V)[0]))

#define test_assert(x) do { \
    if (!(x)) { \
        printk("FAIL: %s (line %d)\n", #x, __LINE__); \
        return -1; \
    } \
} while (0)

/* ------------------------------------------------------------------ */
/* Build a Monster buffer using the bottom-up approach.               */
/* ------------------------------------------------------------------ */
static int create_monster(flatcc_builder_t *B)
{
    flatbuffers_string_ref_t weapon_one_name =
        flatbuffers_string_create_str(B, "Sword");
    flatbuffers_string_ref_t weapon_two_name =
        flatbuffers_string_create_str(B, "Axe");

    ns(Weapon_ref_t) sword = ns(Weapon_create(B, weapon_one_name, 3));
    ns(Weapon_ref_t) axe   = ns(Weapon_create(B, weapon_two_name, 5));

    flatbuffers_string_ref_t name =
        flatbuffers_string_create_str(B, "Orc");

    uint8_t treasure[] = {0, 1, 2, 3, 4, 5, 6, 7, 8, 9};
    flatbuffers_uint8_vec_ref_t inventory =
        flatbuffers_uint8_vec_create(B, treasure, c_vec_len(treasure));

    ns(Weapon_vec_start(B));
    ns(Weapon_vec_push(B, sword));
    ns(Weapon_vec_push(B, axe));
    ns(Weapon_vec_ref_t) weapons = ns(Weapon_vec_end(B));

    ns(Vec3_t) pos = {1.0f, 2.0f, 3.0f};
    int16_t hp   = 300;
    int16_t mana = 150;   /* default — will not be stored */

    ns(Equipment_union_ref_t) equipped = ns(Equipment_as_Weapon(axe));

    ns(Monster_create_as_root(B, &pos, mana, hp, name, inventory,
                              ns(Color_Red), weapons, equipped));
    return 0;
}

/* ------------------------------------------------------------------ */
/* Read back and verify every field of the Monster buffer.            */
/* ------------------------------------------------------------------ */
static int access_monster(const void *buffer)
{
    ns(Monster_table_t) monster = ns(Monster_as_root(buffer));
    test_assert(monster != 0);

    /* Scalars */
    test_assert(ns(Monster_hp(monster))   == 300);
    test_assert(ns(Monster_mana(monster)) == 150);   /* default */

    /* String */
    flatbuffers_string_t name = ns(Monster_name(monster));
    test_assert(name != 0);
    test_assert(strcmp(name, "Orc") == 0);

    /* Struct */
    ns(Vec3_struct_t) pos = ns(Monster_pos(monster));
    test_assert(pos != 0);
    test_assert(ns(Vec3_x(pos)) == 1.0f);
    test_assert(ns(Vec3_y(pos)) == 2.0f);
    test_assert(ns(Vec3_z(pos)) == 3.0f);

    /* Copy struct to native C struct */
    ns(Vec3_t) pos_vec;
    ns(Vec3_copy_from_pe(&pos_vec, pos));
    test_assert(pos_vec.x == 1.0f);
    test_assert(pos_vec.y == 2.0f);
    test_assert(pos_vec.z == 3.0f);

    /* Inventory vector */
    flatbuffers_uint8_vec_t inv = ns(Monster_inventory(monster));
    test_assert(inv != 0);
    test_assert(flatbuffers_uint8_vec_len(inv) == 10);
    test_assert(flatbuffers_uint8_vec_at(inv, 2) == 2);

    /* Weapons vector */
    ns(Weapon_vec_t) weapons = ns(Monster_weapons(monster));
    test_assert(ns(Weapon_vec_len(weapons)) == 2);

    const char *w1_name = ns(Weapon_name(ns(Weapon_vec_at(weapons, 0))));
    test_assert(w1_name != 0 && strcmp(w1_name, "Sword") == 0);
    test_assert(ns(Weapon_damage(ns(Weapon_vec_at(weapons, 0)))) == 3);

    const char *w2_name = ns(Weapon_name(ns(Weapon_vec_at(weapons, 1))));
    test_assert(w2_name != 0 && strcmp(w2_name, "Axe") == 0);
    test_assert(ns(Weapon_damage(ns(Weapon_vec_at(weapons, 1)))) == 5);

    /* Equipment union */
    test_assert(ns(Monster_equipped_type(monster)) == ns(Equipment_Weapon));
    ns(Weapon_table_t) equipped =
        (ns(Weapon_table_t))ns(Monster_equipped(monster));
    test_assert(strcmp(ns(Weapon_name(equipped)), "Axe") == 0);
    test_assert(ns(Weapon_damage(equipped)) == 5);

    return 0;
}

/* ------------------------------------------------------------------ */
int main(void)
{
    flatcc_builder_t builder;
    void  *buf;
    size_t size;

    flatcc_builder_init(&builder);

    if (create_monster(&builder)) {
        printk("FAIL: create_monster\n");
        flatcc_builder_clear(&builder);
        return 1;
    }

    buf = flatcc_builder_finalize_aligned_buffer(&builder, &size);
    if (!buf) {
        printk("FAIL: finalize_aligned_buffer returned NULL\n");
        flatcc_builder_clear(&builder);
        return 1;
    }
    printk("Monster FlatBuffer created: %u bytes\n", (unsigned)size);

    if (access_monster(buf)) {
        printk("FAIL: access_monster\n");
        flatcc_builder_aligned_free(buf);
        flatcc_builder_clear(&builder);
        return 1;
    }

    flatcc_builder_aligned_free(buf);
    flatcc_builder_clear(&builder);

    printk("PASS: Monster created and verified successfully\n");

    return 0;
}
