## CMakeLists.txt
```
cmake_minimum_required(VERSION 3.20.0)

# Repo root carries zephyr/module.yml; registering it here covers
# standalone checkouts, and west workspaces discover the same path anyway.
list(APPEND EXTRA_ZEPHYR_MODULES
  ${CMAKE_CURRENT_LIST_DIR}/../..
)

find_package(Zephyr REQUIRED HINTS $ENV{ZEPHYR_BASE})
project(flatcc_basic)

target_sources(app PRIVATE src/main.c)
target_link_libraries(app PRIVATE flatccrt)
```

## sample.yaml
```
sample:
  name: FlatCC basic raw-builder sample

common:
  tags:
    - flatcc
    - samples
  integration_platforms:
    - native_sim

tests:
  flatcc_zephyr.samples.basic:
    harness: console
    harness_config:
      type: multi_line
      regex:
        - "created 16-byte FlatBuffer with Vec3 struct"
        - "PASS"
    platform_allow:
      - native_sim
    timeout: 20
```

## prj.conf
```kconfig
CONFIG_CONSOLE=y
CONFIG_PRINTK=y

# FlatCC builder uses dynamic allocation internally
CONFIG_HEAP_MEM_POOL_SIZE=4096

CONFIG_FLATCC=y
CONFIG_FLATCC_ALLOC_ZEPHYR=y
CONFIG_FLATCC_RUNTIME_JSON=n
CONFIG_FLATCC_RUNTIME_REFMAP=y
```

## src/main.c
```c
#include <zephyr/kernel.h>
#include <string.h>

#include "flatcc/flatcc_builder.h"

/*
 * Test FlatCC runtime integration with Zephyr.
 *
 * Without schema-generated code we exercise the raw builder/emitter:
 *   1. Initialise flatcc_builder (triggers allocator)
 *   2. Create a buffer containing a struct (Vec3: 3 × float)
 *   3. Retrieve the serialised bytes via the default emitter
 *   4. Verify we got a non-empty buffer
 *   5. Tear down the builder (releases all allocations)
 */

/* A trivial 12-byte struct: three little-endian floats. */
struct vec3 {
    float x;
    float y;
    float z;
};

int main(void)
{
    flatcc_builder_t builder;
    flatcc_builder_t *B = &builder;
    int ret;

    ret = flatcc_builder_init(B);
    if (ret) {
        printk("FAIL: flatcc_builder_init returned %d\n", ret);
        return 1;
    }
    printk("builder initialised (allocator OK)\n");

    /* Open a buffer (no file-identifier, default alignment, no flags). */
    ret = flatcc_builder_start_buffer(B, 0, 0, 0);
    if (ret) {
        printk("FAIL: start_buffer returned %d\n", ret);
        flatcc_builder_clear(B);
        return 1;
    }

    /* Create a struct as the root object. */
    struct vec3 v = { 1.5f, 2.5f, 3.5f };
    flatcc_builder_ref_t root =
        flatcc_builder_create_struct(B, &v, sizeof(v), sizeof(float));

    /* Close the buffer with the struct as root. */
    flatcc_builder_ref_t buf_ref = flatcc_builder_end_buffer(B, root);
    if (!buf_ref) {
        printk("FAIL: end_buffer returned 0\n");
        flatcc_builder_clear(B);
        return 1;
    }

    /* Read back the serialised bytes from the default emitter. */
    size_t size = 0;
    void *buf = flatcc_builder_get_direct_buffer(B, &size);
    if (!buf || size == 0) {
        printk("FAIL: get_direct_buffer returned NULL or zero size\n");
        flatcc_builder_clear(B);
        return 1;
    }

    printk("created %u-byte FlatBuffer with Vec3 struct\n", (unsigned)size);

    /* Quick sanity: the buffer must be at least header(4) + struct(12). */
    if (size >= 16) {
        printk("PASS\n");
    } else {
        printk("FAIL: buffer too small (%u bytes)\n", (unsigned)size);
        flatcc_builder_clear(B);
        return 1;
    }

    flatcc_builder_clear(B);
    printk("builder cleared — all memory freed\n");

    return 0;
}
```
